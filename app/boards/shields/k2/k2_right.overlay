&default_transform {
		map = <
                    RC(2,3) RC(1,3) RC(2,2) RC(1,2) RC(2,1) RC(1,1) RC(0,0)
                    RC(3,3) RC(0,3) RC(3,2) RC(0,2) RC(3,1) RC(0,1) RC(1,0)
                            RC(5,2) RC(4,2) RC(5,1) RC(4,1) RC(5,0) RC(2,0)
            RC(0,4) RC(5,3) RC(4,3)                         RC(4,0) RC(3,0)
		>;
};
