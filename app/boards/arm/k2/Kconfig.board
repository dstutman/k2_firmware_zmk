## app/boards/arm/k2/Kconfig.board
```kconfig
# Copyright (c) 2021 Dan Stutman
# SPDX-License-Identifier: MIT

config BOARD_K2
	bool "K2"
	depends on SOC_NRF52840_QIAA
```

## app/boards/arm/k2/Kconfig.defconfig
```kconfig
# Copyright (c) 2021 Dan Stutman
# SPDX-License-Identifier: MIT

if BOARD_K2

config ZMK_KEYBOARD_NAME
	default "K2"

config BT_CTLR
	default BT

config ZMK_BLE
	default y

config ZMK_USB
	default n

config ZMK_BATTERY_VOLTAGE_DIVIDER
	default n

endif # BOARD_K2
```

## app/boards/shields/k2/Kconfig.defconfig
```kconfig
if SHIELD_K2_LEFT

config ZMK_KEYBOARD_NAME
    default "K2 Left"

endif # SHIELD_K2_LEFT

if SHIELD_K2_RIGHT

config ZMK_KEYBOARD_NAME
    default "K2 Right"

endif # SHIELD_K2_RIGHT
```

## app/boards/shields/k2/Kconfig.shield
```kconfig
# Copyright (c) 2020 The ZMK Contributors
# SPDX-License-Identifier: MIT

config SHIELD_K2_LEFT
    def_bool $(shields_list_contains,k2_left)

config SHIELD_K2_RIGHT
    def_bool $(shields_list_contains,k2_right)
```
